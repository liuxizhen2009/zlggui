/****************************************************************************************
* 文件名：TEST.C
* 功能：GUI测试及演示程序。
* 作者：黄绍斌
* 日期：2003.09.09
****************************************************************************************/
// #include "..//STM32lib//stm32f10x.h"
// #include "..//STM32lib//stm32f10x_gpio.h"
// #include "stdio.h"
#include "..//User//common.h"
#include "..//User//KeyValDefine.h"
#include "..//ZLG_GUI//config.h""

// #define   KEY_ENT    3
// #define   KEY_DOWN  2
// #define   KEY_UP  1


/****************************************************************************
* 名称：DelayNS()
* 功能：长软件延时
* 入口参数：dly		延时参数，值越大，延时越久
* 出口参数：无
****************************************************************************/
void  DelayNS(uint32  dly)
{  uint32  i;

   for(; dly>0; dly--) 
      for(i=0; i<5000; i++);
}


/****************************************************************************
* 名称：WaitKey()
* 功能：等待一个有效按键，并返回按键值。本函数有去抖功能。
* 入口参数：无
* 出口参数：返回按键盘值。
****************************************************************************/

extern INT8U SimKeyPend(void);
uint8  WaitKey(void)
{  uint32  i;
   uint8   key;
   uint8   key_bak;
#if 0  
   key = 0;							// 接收按键
   while(0==key)
   {  key = GetKey();
      for(i=0; i<1000; i++);
   }
   
   key_bak = 1;
   while(0!=key_bak)				// 等待按键放开
   {  key_bak =GetKey();
      for(i=0; i<1000; i++);
   }
#else
	 
	key=SimKeyPend();
#endif	 
   return(key);
}




/****************************************************************************
* 名称：DispLog()
* 功能：显示LOG，用坚线填充屏幕(填充0xAA)。
* 入口参数：无
* 出口参数：无
****************************************************************************/
void  DispLog(void)
{  GUI_FillSCR(0xaa);				// 填充0xAA
   DelayNS(30);
}


/****************************************************************************
* 名称：WaitAKey()
* 功能：等待任一个有效按键，并返回。
* 入口参数：无
* 出口参数：无
****************************************************************************/
void  WaitAKey(void)
{  uint8  key;

   while(1)
   {  key = WaitKey();
      if(key==KEY_DOWN) return;
      if(key==KEY_UP) return;
      if(key==KEY_ENT) return;
   }
}


/****************************************************************************
* 名称：DemoLine()
* 功能：绘画直线演示。
* 入口参数：无
* 出口参数：无
****************************************************************************/
void  DemoLine(void)
{  WINDOWS  demow;
   
   /* 显示演示窗口 */
   demow.x = 45;
   demow.y = 25;
   demow.with = 150;
   demow.hight = 80;
   demow.title = (uint8 *) "Line for Demo";
   demow.state = (uint8 *) "Enter a key return.";
   GUI_WindowsDraw(&demow);
   
   /* 打钩 */
   GUI_Line(90, 60, 110, 90, 1);
   GUI_Line(110, 90, 190, 50, 1);
   GUI_LineWith(50, 60, 70, 90, 3, 1);
   GUI_LineWith(70, 90, 170, 40, 3, 1);
   
   /* 画垂直线及水平线 */
   GUI_RLine(70, 45, 70, 1);
   GUI_HLine(140, 85, 180, 1);
   
   WaitAKey();						// 等待一按键
   GUI_WindowsHide(&demow);
}


/****************************************************************************
* 名称：DemoCircle()
* 功能：绘画圆演示。
* 入口参数：无
* 出口参数：无
****************************************************************************/
void  DemoCircle(void)
{  WINDOWS  demow;
   
   /* 显示演示窗口 */
   demow.x = 45;
   demow.y = 25;
   demow.with = 150;
   demow.hight = 80;
   demow.title = (uint8 *) "Circle for Demo";
   demow.state = (uint8 *) "Enter a key return.";
   GUI_WindowsDraw(&demow);
   
   /* 画两个圆 */
   GUI_CircleFill(75, 60, 15, 1);
   GUI_Circle(100, 70, 5, 1);
   
   /* 画两个交圆，并对交点进行填充 */
   GUI_Circle(135, 65, 20, 1);
   GUI_Circle(155, 65, 20, 1);
   GUI_FloodFill(145, 65, 1);  
   
   WaitAKey();						// 等待一按键
   GUI_WindowsHide(&demow);
}


/****************************************************************************
* 名称：DemoArc()
* 功能：绘画圆弧及扇形演示。
* 入口参数：无
* 出口参数：无
****************************************************************************/
void  DemoArc(void)
{  WINDOWS  demow;
   
   /* 显示演示窗口 */
   demow.x = 45;
   demow.y = 25;
   demow.with = 150;
   demow.hight = 80;
   demow.title = (uint8 *) "Arc for Demo";
   demow.state = (uint8 *) "Enter a key return.";
   GUI_WindowsDraw(&demow);
   
   /* 画两个90度角的弧(第3、1像限) */
   GUI_Arc4(75, 70, 20, 3, 1);
   GUI_Arc4(65, 70, 20, 1, 1);
   
   GUI_Pieslice(110, 75, 20, 0, 135, 1);
   GUI_Arc(130, 60, 20, 30, 90, 1);
   GUI_Pieslice(160, 70, 20, 100, 0, 1);
   GUI_FloodFill(165, 72, 1);
   
   WaitAKey();						// 等待一按键
   GUI_WindowsHide(&demow);
}

/****************************************************************************
* 名称：DemoEllipse()
* 功能：绘画随圆演示。
* 入口参数：无
* 出口参数：无
****************************************************************************/  
void  DemoEllipse(void)
{  WINDOWS  demow;
   
   /* 显示演示窗口 */
   demow.x = 45;
   demow.y = 25;
   demow.with = 150;
   demow.hight = 80;
   demow.title = (uint8 *) "Ellipse for Demo";
   demow.state = (uint8 *) "Enter a key return.";
   GUI_WindowsDraw(&demow);
   
   GUI_Ellipse(50, 100, 50, 80, 1);				
   GUI_Ellipse(110, 130, 45, 90, 1);
   GUI_EllipseFill(140, 190, 60, 90, 1);
     
   WaitAKey();						// 等待一按键
   GUI_WindowsHide(&demow);
}



/****************************************************************************
* 名称：DemoRectang()
* 功能：绘画矩形演示。
* 入口参数：无
* 出口参数：无
****************************************************************************/  
void  DemoRectang(void)
{  WINDOWS  demow;
   
   /* 显示演示窗口 */
   demow.x = 45;
   demow.y = 25;
   demow.with = 150;
   demow.hight = 80;
   demow.title = (uint8 *) "Rectang for Demo";
   demow.state = (uint8 *) "Enter a key return.";
   GUI_WindowsDraw(&demow);
     
   /* 画一个矩形及填充矩形 */
   GUI_Rectangle(50, 45, 90, 85, 1);
   GUI_Rectangle(75, 50, 100, 88, 1);
   GUI_RectangleFill(80, 60, 130, 80, 1);
   GUI_Rectangle(110, 50, 180, 90, 1);
   GUI_Rectangle(135, 40, 190, 70, 1);
   WaitAKey();						// 等待一按键
   GUI_WindowsHide(&demow);
}


uint32  const mline[] = {120,40, 110,55, 90,60, 110,70, 120,90, 130,70, 150,60, 130,55, 120,40};
uint32  const poly5[] = {65,45, 50,60, 50,90, 80,90, 80,60, 65,45};
uint32  const poly4[] = {155,50, 190,50, 155,85, 190,85, 155,50};
/****************************************************************************
* 名称：DemoPoly()
* 功能：绘画多边形演示。
* 入口参数：无
* 出口参数：无
****************************************************************************/  
void  DemoPoly(void)
{  WINDOWS  demow;
   
   /* 显示演示窗口 */
   demow.x = 45;
   demow.y = 25;
   demow.with = 150;
   demow.hight = 80;
   demow.title = (uint8 *) "Poly for Demo";
   demow.state = (uint8 *) "Enter a key return.";
   GUI_WindowsDraw(&demow);
   
   GUI_LineS(poly5, 6, 1);
   GUI_LineS(mline, 9, 1);
   GUI_FloodFill(115, 55, 1);
   GUI_LineS(poly4, 5, 1);
   GUI_FloodFill(160, 52, 1);

   WaitAKey();						// 等待一按键
   GUI_WindowsHide(&demow);
}


/*--  调入了一幅图像：C:\WINDOWS\Desktop\windows.bmp  --*/
/*--  宽度x高度=167x124  --*/
/*--  宽度不是8的倍数，现调整为：宽度x高度=168x124  --*/
uint8  const windows[] = {
0x00,0x00,0x00,0x00,0x00,0x00,0x00,0x00,0x00,0x00,0x00,0x00,0x00,0x00,0x00,0x00,
0x00,0x00,0x00,0x00,0x00,0x00,0x00,0x00,0x00,0x00,0x00,0x00,0x00,0x00,0x00,0x00,
0x00,0x00,0x00,0x00,0x00,0x00,0x00,0x00,0x00,0x00,0x00,0x00,0x00,0x00,0x00,0x00,
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0x00,0x00,0x00,0x00,0x00,0x00,0x00,0x00,0x00,0x00,0x00,0x00
}; 


/*--  文字:  请  --*/
/*--  宋体12;  此字体下对应的点阵为：宽x高=16x16   --*/
uint8  const  hzchar1[]=
{
0x00,0x40,0x47,0xFC,0x30,0x40,0x23,0xF8,0x00,0x40,0x07,0xFE,0xF0,0x00,0x13,0xF8,
0x12,0x08,0x13,0xF8,0x12,0x08,0x13,0xF8,0x16,0x08,0x1A,0x08,0x12,0x28,0x02,0x10
};

/*--  文字:  稍  --*/
/*--  宋体12;  此字体下对应的点阵为：宽x高=16x16   --*/
uint8  const  hzchar2[]=
{
0x0E,0x20,0x79,0x22,0x08,0xA4,0x08,0xA8,0x7D,0xFC,0x19,0x04,0x1D,0x04,0x2B,0xFC,
0x29,0x04,0x49,0x04,0x49,0xFC,0x89,0x04,0x09,0x04,0x09,0x04,0x09,0x14,0x09,0x08
};

/*--  文字:  等  --*/
/*--  宋体12;  此字体下对应的点阵为：宽x高=16x16   --*/
uint8  const  hzchar3[]=
{
0x20,0x80,0x3E,0xFC,0x28,0xA0,0x45,0x10,0x85,0x10,0x3F,0xF8,0x01,0x00,0xFF,0xFE,
0x00,0x20,0x00,0x20,0x7F,0xFC,0x04,0x20,0x02,0x20,0x02,0x20,0x00,0xA0,0x00,0x40
};


/****************************************************************************
* 名称：DemoBmp()
* 功能：绘画bmp图及汉字显示演示。
* 入口参数：无
* 出口参数：无
****************************************************************************/  
void  DemoBmp(void)
{  GUI_ClearSCR();				
   GUI_LoadPic(0, 0, (uint8 *)windows, 168, 124);
   GUI_PutHZ(210, 20, (uint8 *)hzchar1, 16, 16);
   GUI_PutHZ(210, 50, (uint8 *)hzchar2, 16, 16);
   GUI_PutHZ(210, 80, (uint8 *)hzchar3, 16, 16);

   WaitAKey();						// 等待一按键
}


 
/***********************************************************************
* 名称：DispButton49x14()
* 功能：显示一个提示框，当用户确定/取消时退出。
* 入口参数：无
* 出口参数：若是确定键，则返回0，否则返回1
***********************************************************************/
uint8  DispButton49x14(void)
{  uint8  select;
   uint8  key;
   
   WINDOWS  message;

   message.x = 45;
   message.y = 25;
   message.with = 150;
   message.hight = 80;
   message.title = (uint8 *) "Message for Demo";
   message.state = (uint8 *) 0;
   GUI_WindowsDraw(&message);
   GUI_PutString(60, 55, "Start the Demo.");
   
   select = 0;
   while(1)
   {  if(select==0)
      {  GUI_Button_OK1(60,80);
         GUI_Button_Cancle(130,80);
      }
      else
      {  GUI_Button_OK(60,80);
         GUI_Button_Cancle1(130,80);
      }
      
      key = WaitKey();
      if( (key==KEY_DOWN)||(key==KEY_UP) ) select = 1- select;
      if(key==KEY_ENT)
      {  GUI_WindowsHide(&message);
         return(select);
      }
   }

}


volatile uint8  keypress = 0;
/***********************************************************************
* 名称：IRQ_EINT3()
* 功能：外部中断3服务函数。置位keyin，使MoveCircle函数退出。
* 入口参数：无
* 出口参数：无
***********************************************************************/
// void  __irq  IRQ_EINT3(void)
// {  while( (EXTINT&0x08)!=0 )		// 等待外部中断信号恢复为高电平	
//    {  EXTINT = 0x08;				// 清除EINT3中断标志
//    }
//    keypress = 1;
//    VICVectAddr = 0x00;              // 中断处理结束
// }



/***********************************************************************
* 名称：MoveCircle()
* 功能：将三个小球在屏幕上不断的滚动，实现动画操作。
* 入口参数：无
* 出口参数：无
***********************************************************************/
void  MoveCircle(void)
{  WINDOWS  mywindows;

   uint8  x0, y0;
   uint8  x0_bak, y0_bak;
   int8   x0_ver, y0_ver;
   
   uint8  x1, y1;
   uint8  x1_bak, y1_bak;
   int8   x1_ver, y1_ver;
   
   uint8  x2, y2;
   uint8  x2_bak, y2_bak;
   int8   x2_ver, y2_ver;
   
   if(DispButton49x14()==1) return; // 提示确定信息 
   /* 窗口演示 */
   mywindows.x = 0;
   mywindows.y = 0;
   mywindows.with = 240;
   mywindows.hight = 128;
   mywindows.title = (uint8 *) "Hello World!   -- HSB ";
   mywindows.state = (uint8 *) "Use the GUI for windows.";
   GUI_WindowsDraw(&mywindows);
  
   /* 使能外部中断3，用于退出函数 */ 
//   VICIntEnable = 0x020000;		
   keypress = 0;	
   
   x0 = x0_bak= 125;
   y0 = y0_bak = 45;
   x0_ver = 1;
   y0_ver = 1;
   
   x1 = x1_bak = 35;
   y1 = y1_bak = 60;
   x1_ver = -1;
   y1_ver = 1;
   
   x2 = x2_bak = 200;
   y2 = y2_bak = 80;
   x2_ver = 1;
   y2_ver = -1;
   
   while(1)
   {  GUI_Circle(x0, y0, 20, 1);						// 绘画新的圆
      GUI_Circle(x0_bak, y0_bak, 20, 0);				// 擦除原位置上的圆
      x0_bak = x0;										// 保存当前圆的圆心坐标，以便擦除 
      y0_bak = y0;
      
      GUI_Circle(x1, y1, 20, 1);						// 绘画新的圆
      GUI_Circle(x1_bak, y1_bak, 20, 0);				// 擦除原位置上的圆
      x1_bak = x1;										// 保存当前圆的圆心坐标，以便擦除 
      y1_bak = y1;
      
      GUI_Circle(x2, y2, 20, 1);						// 绘画新的圆
      GUI_Circle(x2_bak, y2_bak, 20, 0);				// 擦除原位置上的圆
      x2_bak = x2;										// 保存当前圆的圆心坐标，以便擦除 
      y2_bak = y2;
      
      DelayNS(1);					// 延时
      
      x0 += x0_ver;					// 圆运动计算
      y0 += y0_ver;
      x0 += x0_ver;				
      y0 += y0_ver;
      
      if(x0<=22)					// 移到了最左边吗？若是，则向右运动(x_ver=1)
      {  x0_ver = 1;
      }
      if(x0>=217)					// 移到了最右边吗？若是，则向左运动(x_ver=-1)
      { x0_ver = -1;
      }
      if(y0<=34)					// 移到了最下边吗？若是，则向上运动(y_ver=1)
      {  y0_ver = 1;
      }
      if(y0>=95)					// 移到了最上边吗？若是，则向下动动(y_ver=-1)
      {  y0_ver = -1;
      }
      
      x1 += x1_ver;					// 圆运动计算
      y1 += y1_ver;
      x1 += x1_ver;				
      y1 += y1_ver;
      
      if(x1<=22)					// 移到了最左边吗？若是，则向右运动(x_ver=1)
      {  x1_ver = 1;
      }
      if(x1>=217)					// 移到了最右边吗？若是，则向左运动(x_ver=-1)
      { x1_ver = -1;
      }
      if(y1<=34)					// 移到了最下边吗？若是，则向上运动(y_ver=1)
      {  y1_ver = 1;
      }
      if(y1>=95)					// 移到了最上边吗？若是，则向下动动(y_ver=-1)
      {  y1_ver = -1;
      }
      
      x2 += x2_ver;					// 圆运动计算
      y2 += y2_ver;
      x2 += x2_ver;				
      y2 += y2_ver;
      
      if(x2<=22)					// 移到了最左边吗？若是，则向右运动(x_ver=1)
      {  x2_ver = 1;
      }
      if(x2>=217)					// 移到了最右边吗？若是，则向左运动(x_ver=-1)
      { x2_ver = -1;
      }
      if(y2<=34)					// 移到了最下边吗？若是，则向上运动(y_ver=1)
      {  y2_ver = 1;
      }
      if(y2>=95)					// 移到了最上边吗？若是，则向下动动(y_ver=-1)
      {  y2_ver = -1;
      }
      
      if(0!=keypress) break;
   }
   
 //  VICIntEnClr = 0x020000;		
}




/*--  调入了一幅图像：C:\WINDOWS\Desktop\Pen04.ico  --*/
/*--  宽度x高度=32x32  --*/
uint8  const  menuico1[]=
{
0x00,0x00,0x00,0x60,0x00,0x00,0x00,0xF8,0x00,0x00,0x01,0xFC,0x00,0x00,0x03,0xFE,
0x00,0x00,0x07,0xFE,0x00,0x00,0x0F,0xFF,0x00,0x00,0x1F,0xFF,0x00,0x00,0x3F,0xFE,
0x00,0x00,0x7F,0xFC,0x00,0x00,0xFF,0xF8,0x00,0x01,0xFF,0xF0,0x00,0x03,0xFF,0xE0,
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0x2C,0x00,0x00,0x00,0x50,0x00,0x00,0x00,0x60,0x00,0x00,0x00,0x80,0x00,0x00,0x00
};

/*--  调入了一幅图像：C:\WINDOWS\Desktop\menu1.bmp  --*/
/*--  宽度x高度=42x13  --*/
/*--  宽度不是8的倍数，现调整为：宽度x高度=48x13  --*/
uint8  const  menuchar1[]=
{
0x00,0x00,0x00,0x00,0x00,0x00,0x00,0x10,0x00,0x22,0x80,0x00,0x03,0xFF,0x80,0x22,
0x40,0x00,0x00,0x10,0x00,0x52,0x60,0x00,0x00,0xFE,0x00,0x97,0x80,0x00,0x00,0x82,
0x00,0xE2,0x60,0x00,0x00,0x82,0x00,0x4F,0x80,0x00,0x00,0xFE,0x00,0xB2,0x40,0x00,
0x00,0x82,0x00,0xC2,0x80,0x00,0x00,0xFE,0x00,0x31,0x20,0x00,0x00,0x82,0x00,0xC6,
0xA0,0x00,0x03,0xFF,0x80,0x18,0x60,0x00,0x00,0x00,0x00,0x00,0x00,0x00
};


/*--  调入了一幅图像：C:\WINDOWS\Desktop\Misc36.ico  --*/
/*--  宽度x高度=32x32  --*/
uint8  const  menuico2[]=
{
0x00,0x00,0x00,0x00,0x00,0x01,0x00,0x00,0x00,0x03,0x80,0x00,0x00,0x07,0xC0,0x00,
0x00,0x0F,0xE0,0x00,0x00,0x1F,0xF0,0x00,0x00,0x1F,0xF8,0x00,0x00,0x3F,0xF8,0x00,
0x00,0x7F,0xFC,0x00,0x00,0xFF,0xFE,0x00,0x00,0xFF,0xFF,0x00,0x01,0xFF,0xFF,0x00,
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0x00,0x01,0xC0,0x00,0x00,0x01,0x80,0x00,0x00,0x00,0x80,0x00,0x00,0x00,0x00,0x00
};

/*--  调入了一幅图像：C:\WINDOWS\Desktop\menu2.bmp  --*/
/*--  宽度x高度=42x13  --*/
/*--  宽度不是8的倍数，现调整为：宽度x高度=48x13  --*/
uint8  const  menuchar2[]=
{
0x00,0x00,0x00,0x00,0x00,0x00,0x00,0x00,0xFF,0xC0,0x00,0x00,0x00,0x00,0x80,0x40,
0x00,0x00,0x00,0x00,0xBE,0x40,0x00,0x00,0x00,0x00,0xA2,0x40,0x00,0x00,0x00,0x00,
0xBF,0x40,0x00,0x00,0x00,0x00,0xA1,0x40,0x00,0x00,0x00,0x00,0xA9,0x40,0x00,0x00,
0x00,0x00,0xAD,0x40,0x00,0x00,0x00,0x00,0x92,0x40,0x00,0x00,0x00,0x00,0xA1,0x40,
0x00,0x00,0x00,0x00,0xFF,0xC0,0x00,0x00,0x00,0x00,0x00,0x00,0x00,0x00
};


/*--  调入了一幅图像：C:\WINDOWS\Desktop\Misc35.ico  --*/
/*--  宽度x高度=32x32  --*/
uint8  const  menuico3[]=
{
0x00,0x00,0x00,0x00,0x00,0x07,0xC0,0x00,0x00,0x1F,0xF0,0x00,0x00,0x3F,0xF8,0x00,
0x00,0x3F,0xFC,0x00,0x00,0x7F,0xFC,0x00,0x00,0x7F,0xFE,0x00,0x00,0x7F,0xFE,0x00,
0x00,0x7F,0xFE,0x00,0x07,0xFF,0xFF,0xC0,0x1F,0xFF,0xFF,0xF0,0x3F,0xFF,0xFF,0xF8,
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0x1F,0xFF,0xFF,0xF0,0x3F,0xFF,0xFF,0xF8,0x1F,0xFF,0xFF,0xFC,0x00,0x00,0x00,0x00
};


/*--  调入了一幅图像：C:\WINDOWS\Desktop\menu3.bmp  --*/
/*--  宽度x高度=42x13  --*/
/*--  宽度不是8的倍数，现调整为：宽度x高度=48x13  --*/
uint8  const  menuchar3[]=
{
0x00,0x00,0x00,0x00,0x00,0x00,0x01,0xFF,0x80,0xE1,0xC0,0x00,0x01,0x00,0x80,0x2E,
0x80,0x00,0x01,0x7C,0x80,0x2A,0x80,0x00,0x01,0x44,0x80,0xEA,0x80,0x00,0x01,0x7E,
0x80,0x8A,0x80,0x00,0x01,0x42,0x80,0x8A,0x80,0x00,0x01,0x52,0x80,0xEA,0x40,0x00,
0x01,0x5A,0x80,0x2A,0x40,0x00,0x01,0x24,0x80,0x2A,0xC0,0x00,0x01,0x42,0x80,0x2B,
0x20,0x00,0x01,0xFF,0x80,0xD0,0x20,0x00,0x00,0x00,0x00,0x00,0x00,0x00
};


/*--  调入了一幅图像：C:\WINDOWS\Desktop\Misc34.ico  --*/
/*--  宽度x高度=32x32  --*/
uint8  const  menuico4[]=
{
0x00,0x00,0x00,0x00,0x03,0xE0,0x0F,0x80,0x0F,0xF8,0x3F,0xE0,0x1F,0xFC,0x7F,0xF0,
0x3F,0xFE,0xFF,0xF8,0x3F,0xFF,0xFF,0xFC,0x7F,0xFF,0xFF,0xFC,0x7F,0xFF,0xFF,0xFE,
0x7F,0xFF,0xFF,0xFE,0x7F,0xFF,0xFF,0xFE,0x7F,0xFF,0xFF,0xFE,0x3F,0xFF,0xFF,0xFE,
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0x00,0x01,0xC0,0x00,0x00,0x01,0x80,0x00,0x00,0x00,0x80,0x00,0x00,0x00,0x00,0x00
};


/*--  调入了一幅图像：C:\WINDOWS\Desktop\menu4.bmp  --*/
/*--  宽度x高度=42x13  --*/
/*--  宽度不是8的倍数，现调整为：宽度x高度=48x13  --*/
uint8  const  menuchar4[]=
{
0x00,0x00,0x00,0x00,0x00,0x00,0x01,0x02,0x00,0x7F,0xE0,0x00,0x01,0x3A,0x00,0x40,
0x20,0x00,0x03,0xEF,0x80,0x5F,0x20,0x00,0x01,0x2C,0x00,0x51,0x20,0x00,0x01,0xB7,
0x80,0x5F,0xA0,0x00,0x03,0x6C,0x80,0x50,0xA0,0x00,0x03,0x2F,0x80,0x54,0xA0,0x00,
0x01,0x3C,0x80,0x56,0xA0,0x00,0x01,0x27,0x80,0x49,0x20,0x00,0x01,0x24,0x80,0x50,
0xA0,0x00,0x01,0x25,0x80,0x7F,0xE0,0x00,0x00,0x00,0x00,0x00,0x00,0x00
};

/*--  调入了一幅图像：C:\WINDOWS\Desktop\Misc37.ico  --*/
/*--  宽度x高度=32x32  --*/
uint8  const  menuico5[]=
{
0x00,0x00,0x00,0x00,0x00,0x01,0x00,0x00,0x00,0x03,0x80,0x00,0x00,0x07,0xC0,0x00,
0x00,0x1F,0xF0,0x00,0x00,0x3F,0xF8,0x00,0x00,0x7F,0xFC,0x00,0x00,0xFF,0xFE,0x00,
0x03,0xFF,0xFF,0x80,0x07,0xFF,0xFF,0xC0,0x1F,0xFF,0xFF,0xF0,0x3F,0xFF,0xFF,0xF8,
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0x1F,0xFF,0xFF,0xF0,0x3F,0xFF,0xFF,0xF8,0x1F,0xFF,0xFF,0xFC,0x00,0x00,0x00,0x00
};

/*--  调入了一幅图像：C:\WINDOWS\Desktop\menu5.bmp  --*/
/*--  宽度x高度=42x13  --*/
/*--  宽度不是8的倍数，现调整为：宽度x高度=48x13  --*/
uint8  const  menuchar5[]=
{
0x00,0x00,0x00,0x00,0x00,0x00,0x00,0x8F,0xC0,0x02,0x20,0x00,0x00,0x88,0x00,0x7F,
0x20,0x00,0x01,0xF8,0x00,0x12,0x40,0x00,0x01,0x4F,0x80,0x12,0x80,0x00,0x00,0x48,
0x80,0x7F,0x20,0x00,0x01,0xF8,0x80,0x12,0x40,0x00,0x00,0x48,0x80,0x12,0x80,0x00,
0x00,0x4F,0x80,0x13,0x10,0x00,0x00,0xA8,0x00,0x22,0x20,0x00,0x00,0x98,0x00,0x22,
0xC0,0x00,0x01,0x0F,0xC0,0x43,0x00,0x00,0x00,0x00,0x00,0x00,0x00,0x00
};



/*--  调入了一幅图像：C:\WINDOWS\Desktop\Audio.ico  --*/
/*--  宽度x高度=32x32  --*/
uint8  const  menuico6[]=
{
0x03,0x00,0x00,0x00,0x03,0x80,0x00,0x00,0x03,0xE0,0x00,0x00,0x03,0xF8,0x00,0x00,
0x02,0x78,0x00,0x00,0x02,0x38,0x00,0x00,0x02,0x0B,0xF0,0x00,0x1E,0x1F,0xFE,0x00,
0x2E,0x7F,0xFF,0x80,0x3E,0xFF,0xFF,0xC0,0x3F,0xFF,0xFF,0xA0,0x1F,0xBF,0xFF,0x50,
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0x00,0xFF,0xFF,0xC0,0x00,0x7F,0xFF,0x80,0x00,0x1F,0xFE,0x00,0x00,0x07,0xF0,0x00
};

/*--  调入了一幅图像：C:\WINDOWS\Desktop\menu6.bmp  --*/
/*--  宽度x高度=44x13  --*/
/*--  宽度不是8的倍数，现调整为：宽度x高度=48x13  --*/
uint8  const  menuchar6[]=
{
0x00,0x00,0x00,0x00,0x00,0x00,0x00,0x40,0x42,0x00,0x44,0x00,0x00,0xFC,0x22,0x4F,
0xE4,0x00,0x01,0x88,0x2F,0xE2,0x48,0x00,0x06,0x50,0x02,0x42,0x50,0x00,0x00,0xE0,
0xC2,0x4F,0xE4,0x00,0x07,0x40,0x42,0x42,0x48,0x00,0x00,0xFE,0x44,0x42,0x50,0x00,
0x01,0x04,0x48,0x42,0x62,0x00,0x06,0x98,0x53,0x84,0x44,0x00,0x00,0x60,0xA0,0x04,
0x58,0x00,0x0F,0x80,0x9F,0xE8,0x60,0x00,0x00,0x00,0x00,0x00,0x00,0x00
};


/*--  调入了一幅图像：C:\WINDOWS\Desktop\Misc28.ico  --*/
/*--  宽度x高度=32x32  --*/
uint8  const  menuico7[]=
{
0x07,0x01,0x01,0xC0,0x0F,0x81,0x03,0xE0,0x1F,0xC1,0x07,0xF0,0x1F,0xC1,0x07,0xF0,
0x1F,0xC1,0x07,0xF0,0x0F,0x81,0x03,0xE0,0x07,0x01,0x01,0xC0,0x60,0x31,0x18,0x0C,
0xFD,0xF9,0x3E,0x3E,0xFD,0xF9,0x3F,0xFE,0xFD,0xF9,0x3F,0xFE,0xFD,0xF9,0x37,0xF6,
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0x1D,0xC1,0x03,0x60,0x1D,0xC1,0x03,0x60,0x1D,0xC1,0x03,0x60,0x0D,0x81,0x03,0x60
};


/*--  调入了一幅图像：C:\WINDOWS\Desktop\menu7.bmp  --*/
/*--  宽度x高度=44x13  --*/
/*--  宽度不是8的倍数，现调整为：宽度x高度=48x13  --*/
uint8  const  menuchar7[]=
{
0x00,0x00,0x00,0x00,0x00,0x00,0x7F,0xE0,0x20,0x20,0x10,0x00,0x48,0x20,0x17,0xF1,
0xFF,0x80,0x5F,0x20,0x02,0x23,0x00,0x80,0x6A,0x20,0x4A,0x20,0xFE,0x00,0x44,0x20,
0x2A,0x40,0x08,0x00,0x4A,0x20,0x11,0x40,0x10,0x00,0x75,0xA0,0x11,0x43,0xFF,0x80,
0x42,0x28,0x60,0x80,0x10,0x00,0x4C,0x26,0x21,0x40,0x10,0x00,0x42,0x22,0x22,0x20,
0x10,0x00,0x7F,0xE0,0x2C,0x10,0x70,0x00,0x00,0x00,0x00,0x00,0x00,0x00
};


/*--  调入了一幅图像：C:\WINDOWS\Desktop\Question.ico  --*/
/*--  宽度x高度=32x32  --*/
uint8  const  menuico8[]=
{
0x00,0x0F,0xF0,0x00,0x00,0x7F,0xFE,0x00,0x01,0xFF,0xFF,0x80,0x03,0xF8,0x1F,0xC0,
0x07,0xE0,0x07,0xE0,0x0F,0xC0,0x03,0xF0,0x1F,0xC0,0x03,0xF8,0x3F,0x80,0x01,0xFC,
0x3F,0x80,0x01,0xFC,0x7F,0x81,0x81,0xFE,0x7F,0x81,0x81,0xFE,0x7F,0x81,0x81,0xFE,
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0x03,0xF8,0x1F,0xC0,0x01,0xFE,0x7F,0x80,0x00,0x7F,0xFE,0x00,0x00,0x0F,0xF0,0x00
};


/*--  调入了一幅图像：C:\WINDOWS\Desktop\menu8.bmp  --*/
/*--  宽度x高度=44x13  --*/
/*--  宽度不是8的倍数，现调整为：宽度x高度=48x13  --*/
uint8  const  menuchar8[]=
{
0x00,0x00,0x00,0x00,0x00,0x00,0x00,0x02,0x00,0x7F,0xF0,0x00,0x01,0xF2,0x00,0x00,
0x00,0x00,0x00,0x02,0x00,0x0F,0xC0,0x00,0x00,0x07,0xC0,0x2A,0x50,0x00,0x01,0xFA,
0x40,0x2A,0x50,0x00,0x00,0x42,0x40,0x2F,0xD0,0x00,0x00,0xA2,0x40,0x2A,0x50,0x00,
0x01,0x12,0x40,0x2A,0x50,0x00,0x01,0xF4,0x40,0x2F,0xD0,0x00,0x01,0x08,0x80,0x20,
0x10,0x00,0x00,0x13,0x80,0x3F,0xF0,0x00,0x00,0x00,0x00,0x00,0x00,0x00
};


/****************************************************************************
* 名称：RunDemo()
* 功能：进行GUI的演示，包括画线、画圆、圆弧、椭圆、矩形、多边形、bmp图及汉字、动画等。
* 入口参数：无
* 出口参数：无
****************************************************************************/
void  RunDemo(void)
{  WINDOWS  mainwindows;
   MENUICO  mainmenu[8];
   uint8  select;					// 菜单选项变量
   uint8  key;
   uint8  i;
   
   /* 设置主窗口并显示输出 */
   mainwindows.x = 0;
   mainwindows.y = 0;
   mainwindows.with = 240;
   mainwindows.hight = 128;
   mainwindows.title = (uint8 *) "Graphics Function  Demo!";
   mainwindows.state = NULL;
   GUI_WindowsDraw(&mainwindows);	// 绘制主窗口	
   
   /* 设置图标菜单 */
   for(i=0; i<8; i++)
   {  if(i<4)
      {  mainmenu[i].x = i*59+11; 
         mainmenu[i].y = 20;
      }
      else
      {  mainmenu[i].x = (i-4)*59+11;
         mainmenu[i].y = 72;
      }
      mainmenu[i].state = 0;		// 初始化为末选中状态
   }
   
   
   /* 连接相应的图标数据 */
   mainmenu[0].icodat = (uint8 *) menuico1;
   mainmenu[0].title = (uint8 *) menuchar1;
   mainmenu[1].icodat = (uint8 *) menuico2;
   mainmenu[1].title = (uint8 *) menuchar2;
   mainmenu[2].icodat = (uint8 *) menuico3;
   mainmenu[2].title = (uint8 *) menuchar3;
   mainmenu[3].icodat = (uint8 *) menuico4;
   mainmenu[3].title = (uint8 *) menuchar4;
   mainmenu[4].icodat = (uint8 *) menuico5;
   mainmenu[4].title = (uint8 *) menuchar5;
   mainmenu[5].icodat = (uint8 *) menuico6;
   mainmenu[5].title = (uint8 *) menuchar6;
   mainmenu[6].icodat = (uint8 *) menuico7;
   mainmenu[6].title = (uint8 *) menuchar7;
   mainmenu[7].icodat = (uint8 *) menuico8;
   mainmenu[7].title = (uint8 *) menuchar8;
      
   /* 连接菜单功能函数 */
   mainmenu[0].Function = (void(*)())DemoLine;
   mainmenu[1].Function = (void(*)())DemoCircle;
   mainmenu[2].Function = (void(*)())DemoArc;
   mainmenu[3].Function = (void(*)())DemoEllipse;
   mainmenu[4].Function = (void(*)())DemoRectang;
   mainmenu[5].Function = (void(*)())DemoPoly;
   mainmenu[6].Function = (void(*)())DemoBmp;
   mainmenu[7].Function = (void(*)())MoveCircle;
 
   /* 设置默认菜单 */
   mainmenu[0].state = 1;
   select = 0;
   
   /* 进行主菜单显示及选择操作 */
   while(1)
   {  for(i=0; i<8; i++)								// 显示图标菜单
      {  GUI_MenuIcoDraw(&mainmenu[i]);
      }
      /* 选择功能 */
      while(1)
      {  key = WaitKey();
         if(key==KEY_ENT) break;							// 点击OK键选择
         if(key==KEY_DOWN) 
         {  mainmenu[select].state = 0;					// 取消上一选择
            GUI_MenuIcoDraw(&mainmenu[select]);
            select++;									// 指向下一菜单
            if(select>7) select=0;
			mainmenu[select].state = 1;				
            GUI_MenuIcoDraw(&mainmenu[select]);
         }
         if(key==KEY_UP) 
         {  mainmenu[select].state = 0;					// 取消上一选择
            GUI_MenuIcoDraw(&mainmenu[select]);
            if(select==0) select=7;
              else  select--;							// 指向下一菜单
			mainmenu[select].state = 1;				
            GUI_MenuIcoDraw(&mainmenu[select]);
         }
      }
      
      /* 执行相应功能 */
      (*mainmenu[select].Function)();
      if(select>=6) GUI_WindowsDraw(&mainwindows);	// 主窗口重绘(清屏)
   }
}


/*--  调入了一幅图像：C:\WINDOWS\Desktop\Critter2.ico  --*/
/*--  宽度x高度=32x32  --*/
uint8  const  critter[]=
{
0x00,0x00,0x00,0x00,0x00,0x00,0x00,0x00,0x00,0x00,0x00,0x00,0x00,0x00,0x00,0x00,
0x03,0xF0,0x00,0x00,0x07,0xFC,0x00,0x00,0x0C,0x9F,0x00,0x00,0x1A,0xCF,0x80,0x00,
0x1C,0x8F,0x80,0x00,0x1F,0xFF,0xC0,0x00,0x1F,0xFF,0xE0,0x00,0x0F,0xFF,0xF0,0x00,
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0x00,0x3F,0xFF,0x80,0x00,0x7F,0x9F,0x00,0x00,0x7F,0x1F,0x00,0x00,0x7E,0x1F,0x00
};

/****************************************************************************
* 名称：RunOpen()
* 功能：执行"Open"菜单命令，打开一个图标。
* 入口参数：无
* 出口参数：无
****************************************************************************/
void  RunOpen(void)
{  GUI_LoadPic(105, 70, (uint8 *)critter, 32, 32);
}

/****************************************************************************
* 名称：RunClose()
* 功能：执行"Close"菜单命令，关闭一个图标。
* 入口参数：无
* 出口参数：无
****************************************************************************/
void  RunClose(void)
{  GUI_RectangleFill(105, 70, 137, 102, 0);
   
}

/****************************************************************************
* 名称：RunBye()
* 功能：执行"Exit"菜单命令，显示退出信息。
* 入口参数：无
* 出口参数：无
****************************************************************************/
void  RunBye(void)
{  GUI_PutString(80, 105, "Goodbye sir!");
   DelayNS(50);
}

/****************************************************************************
* 名称：NotThing()
* 功能：显示执行信息，然后退出。
* 入口参数：无
* 出口参数：无
****************************************************************************/
void  NotThing(void)
{  GUI_PutString(80, 105, "Do notthing!");
   DelayNS(50);
   GUI_PutString(80, 105, "            ");
}


/****************************************************************************
* 名称：RunAbout()
* 功能：显示关于信息，然后退出。
* 入口参数：无
* 出口参数：无
****************************************************************************/
void  RunAbout(void)
{  GUI_PutString(80, 105, "ZLG_GUI v0.1");
   DelayNS(100);
   GUI_PutString(80, 105, "            ");
}


/****************************************************************************
* 名称：RunMenuDemo()
* 功能：进行菜单的演示操作。
* 入口参数：无
* 出口参数：无
****************************************************************************/
void  RunMenuDemo(void)
{  WINDOWS  mainwindows;
   MMENU    mainmenu;
   SMENU    submenu[5];
//   uint8    mselect;
   uint8    select=0, bak;
   uint8    key;
      
   /* 设置主窗口并显示输出 */
   mainwindows.x = 0;									
   mainwindows.y = 0;
   mainwindows.with = 128;
   mainwindows.hight = 64;
   mainwindows.title = (uint8 *) "liuxizhen";
   mainwindows.state = (uint8 *) "OK";
   GUI_RecDataFill(&mainwindows);
	
	
   GUI_WindowsDraw(&mainwindows);						// 绘制主窗口	
   
   mainmenu.win = &mainwindows;							// 设置主菜单所属窗口
   mainmenu.no = 5;										// 主菜单项个数
   mainmenu.state=0;
   mainmenu.str[0] = (char *) "1File";					// 主菜单项各项字符
   mainmenu.str[1] = (char *) "2Edit";
   mainmenu.str[2] = (char *) "3View";
   mainmenu.str[3] = (char *) "4Find";
    mainmenu.str[4] = (char *) "Help";
   GUI_MMenuDraw(&mainmenu);							// 显示主菜单
   
   /* 子菜单设置 */
   for(bak=0; bak<4; bak++)
   {  submenu[bak].win = &mainwindows;					// 设置菜单所属的窗口
      submenu[bak].mmenu_no = bak;          
      submenu[bak].state = 0;
   }
   
   submenu[0].no = 3;
   submenu[0].str[0] = (char *) "1Open";
   submenu[0].str[1] = (char *) "2Close";
   submenu[0].str[2] = (char *) "3Exit";
   submenu[0].Function[0] = (void(*)()) RunOpen;
   submenu[0].Function[1] = (void(*)()) RunClose;
   submenu[0].Function[2] = (void(*)()) RunBye;
  
   submenu[1].no = 4;
   submenu[1].str[0] = (char *) "1Cut";
   submenu[1].str[1] = (char *) "2Copy";
   submenu[1].str[2] = (char *) "3Paste";
   submenu[1].str[3] = (char *) "4Delete";
   submenu[1].Function[0] = (void(*)()) NotThing;
   submenu[1].Function[1] = (void(*)()) NotThing;
   submenu[1].Function[2] = (void(*)()) NotThing;
   submenu[1].Function[3] = (void(*)()) NotThing;

   submenu[2].no = 2;
   submenu[2].str[0] = (char *) "1Tools";
   submenu[2].str[1] = (char *) "2Font";
   submenu[2].Function[0] = (void(*)()) NotThing;
   submenu[2].Function[1] = (void(*)()) NotThing;
   
   submenu[3].no = 3;
   submenu[3].str[0] = (char *) "1Find";
   submenu[3].str[1] = (char *) "2Replace";
   submenu[3].str[2] = (char *) "3Next";
   submenu[3].Function[0] = (void(*)()) NotThing;
   submenu[3].Function[1] = (void(*)()) NotThing;
   submenu[3].Function[2] = (void(*)()) NotThing;
//  submenu[3].Function[3] = (void(*)()) NotThing;   
   
   submenu[4].no = 1;
   submenu[4].str[0] = (char *) "About";
   submenu[4].Function[0] = (void(*)()) RunAbout;
   
   
   /* 进行子菜单1显示及选择操作 */
   //mselect = 0;
   while(1)
   {  /* 选择主菜单项 */
      while(1)
      {  
		 GUI_MMenuSelect(&mainmenu, mainmenu.state);			// 显示当前主菜单项
         key  = WaitKey();								// 等待按键操作
         if(key==KEY_ENT) {
			 LWIP_DEBUGF(GUI_DEBUG|DBG_ON,("KEY_ENT:MM=%d,SM=%d\n",mainmenu.state,select)); 
			 break;							// 若是OK键，则退出主菜单选择
		 }
         if(key==KEY_DOWN)								// BACK键操作
         {  
			LWIP_DEBUGF(GUI_DEBUG|DBG_ON,("KEY_UP:MM=%d,SM=%d\n",mainmenu.state,select));
			
			 if( mainmenu.state<=(mainmenu.no-1) )						
            {  
				
				GUI_MMenuNSelect(&mainmenu, mainmenu.state); 	// 取消当前主菜单项选择
                mainmenu.state++;								// 指向下一主菜单项
            }
             if(mainmenu.state>=mainmenu.no) {
 				mainmenu.state= 0;
 			}
//			GUI_MMenuDraw(&mainmenu);						// 绘制主窗口	
			GUI_MMenuSelect(&mainmenu, mainmenu.state);			// 显示当前主菜单项
         }
         if(key==KEY_UP)								// NEXT键操作
         {  
			LWIP_DEBUGF(GUI_DEBUG|DBG_ON,("KEY_DOWN:MM=%d,SM=%d\n",mainmenu.state,select));
			
			 if( 0<=mainmenu.state )						
            {  
				GUI_MMenuNSelect(&mainmenu, mainmenu.state); 	// 取消当前主菜单项选择
                mainmenu.state--;								// 指向下一主菜单项
            }
            if(mainmenu.state>=mainmenu.no) {
 				mainmenu.state=mainmenu.no-1;
 			}
			GUI_MMenuSelect(&mainmenu, mainmenu.state);			// 显示当前主菜单项
         }         
      }
      GUI_MMenuNSelect(&mainmenu, mainmenu.state);
      
      /* 下拉子菜单，选择功能 */
      select = submenu[mainmenu.state].state;
      bak = select;
	  //void  GUI_RectangleFill(uint32 x0, uint32 y0, uint32 x1, uint32 y1, TCOLOR color)
	  //mainwindows  win->y + win->hight - 11
	  GUI_RectangleFill(mainwindows.x+1,mainwindows.y+12+1, \
		mainwindows.x+mainwindows.with-2, mainwindows.y+mainwindows.hight-2-11,back_color);
      GUI_SMenuDraw(&submenu[mainmenu.state]);					// 显示子菜单
      while(1)
      {  key = WaitKey();
         if(key==KEY_ENT) {
			 LWIP_DEBUGF(GUI_DEBUG,("KEY_ENT:MM=%d,SM=%d\n",mainmenu.state,select)); 
			 break;// 点击OK键选择
			 }							
         if(key==KEY_DOWN){  
			LWIP_DEBUGF(GUI_DEBUG,("KEY_DOWN:MM=%d,SM=%d\n",mainmenu.state,select));
			bak = select;
            select++;
            if(select>=submenu[mainmenu.state].no) select = 0;
            GUI_SMenuSelect(&submenu[mainmenu.state], bak, select);
			}
         if(key==KEY_UP){  
			 LWIP_DEBUGF(GUI_DEBUG,("KEY_UP:MM=%d,SM=%d\n",mainmenu.state,select));
			 bak = select;
            if(select==0) select = submenu[mainmenu.state].no - 1;
              else select--;
            GUI_SMenuSelect(&submenu[mainmenu.state], bak, select);
			}
      }
      GUI_SMenuHide(&submenu[mainmenu.state]);//清除客户区了
	  						// 显示主菜单
      //(*submenu[mainmenu.state].Function[select])();					// 调用相应的服务程序
	  //mselect=0;
	  GUI_MMenuDraw(&mainmenu);	
//       if( (mainmenu.state==0) && (select==2) )
//       {  
// 		  break;
//       }
   }
}

/**************************************************************/

