
/**
@author liuxizhen
@data 2013年3月23日9:01:40
@brief  jlx12864驱动

*/

/* Test program for JLX12864G-0086 
   Driver IC is UC1701X(or competible) 
   Programmed by Ken,Dec.24,2010 
   JLX electronic Co.,ltd,    
   http://www.jlxlcd.cn; 
  */ 
// #include <reg51.H> 
//  
// sbit cs1=P1^1; 
// sbit reset=P1^0; 
// sbit rs=P3^0; 
// sbit sclk=P3^1; 
// sbit sid=P3^2;//sid 就是 SDA,串行数据信号 
/*
rst-->PE1
cs-->PD4
rs(Register select)-->PD5
sclk--->PD7
sid-->pd11
*/
//reset=0  RESET_L
//reset=1  RESET_H 
//cs1=0   CS1_L   void GPIO_SetBits(GPIO_TypeDef* GPIOx, uint16_t GPIO_Pin);
//cs1=1  CS1_H 


//rs=0; RS_L
//rs=1;RS_H
//sclk=0;SCK_L
//sclk=1;SCK_H
//sid=0 ;SID_L
//sid=1; SID_H

#include "stdio.h"
#include "..//STM32Lib//stm32f10x_gpio.h"


#define CS1_L 			GPIO_ResetBits(GPIOD, GPIO_Pin_4)		//预置高	 PD11-CS
#define CS1_H				GPIO_SetBits(GPIOD, GPIO_Pin_4)		//预置高	 PD11-CS
#define RESET_L			GPIO_ResetBits(GPIOE, GPIO_Pin_1)
#define RESET_H			GPIO_SetBits(GPIOE, GPIO_Pin_1)
#define RS_L				GPIO_ResetBits(GPIOD, GPIO_Pin_5)
#define RS_H				GPIO_SetBits(GPIOD, GPIO_Pin_5)

#define SCK_L				GPIO_ResetBits(GPIOD, GPIO_Pin_7)
#define SCK_H				GPIO_SetBits(GPIOD, GPIO_Pin_7)
#define SID_L				GPIO_ResetBits(GPIOD, GPIO_Pin_11)
#define SID_H  			GPIO_SetBits(GPIOD, GPIO_Pin_11)

#define KEY_INT   	GPIO_ReadInputDataBit(GPIOB,GPIO_Pin_15)




 
 
void Transfer_data(int data1); 
void Transfer_command(int data1); 
unsigned char graphic1[]; 
 
void Delay(int i); 
void Delay1(int i); 
void DisplayGraphic1(); 
void Initial_Lcd(); 
void clear_screen(); 
void Switch(); 
 
 
 //===============main program=================== 
void LcdDisplay(void) 
 { 
      int i,j,k; 
     Initial_Lcd(); 
      while(1) 
      { 
				clear_screen();    //clear all dots 
        DisplayGraphic1();  //display a picture of 128*64 dots 
        Switch();
				clear_screen();    //clear all dots 
				Delay(50000);
       } 
} 

//============initial 
void Initial_Lcd() 
{ 
      RESET_L;                 //Reset the chip when RESET_L  
      Delay(50); 
      RESET_H; 
      Delay(50);         
   Transfer_command(0xe2);     /*软复位*/ 
   Transfer_command(0x2c);     /*升压步聚 1*/  
   Transfer_command(0x2e);     /*升压步聚 2*/ 
   Transfer_command(0x2f);     /*升压步聚 3*/ 
   Transfer_command(0x23);     /*粗调对比度，可设置范围 20～27*/ 
   Transfer_command(0x81);     /*微调对比度*/ 
   Transfer_command(0x28);     /*微调对比度的值，可设置范围 0～63*/ 
   Transfer_command(0xa2);     /*1/9 偏压比（bias）*/ 
   Transfer_command(0xc8);     /*行扫描顺序：从上到下*/ 
   Transfer_command(0xa0);     /*列扫描顺序：从左到右*/ 
	 //Transfer_command(0xa1);
   Transfer_command(0xaf);     /*开显示*/ 
} 

//===============clear all dot martrics============= 
void clear_screen() 
{ 
unsigned char i,j; 
    for(i=0;i<9;i++) 
    { 
      CS1_L; 
      Transfer_command(0xb0+i); 
      Transfer_command(0x10); 
			Transfer_command(0x00); 
      for(j=0;j<132;j++) 
      { 
             Transfer_data(0x00); 
      } 
    } 
} 
 
 
//==================display a piture of 128*64 dots================ 
void DisplayGraphic1() 
{ 
    unsigned char  *address;    //define pointer 
    int i,j; 
    address=graphic1;   //data pointer:point to "graphic[]",one-dimensional array 
    for(i=0;i<8;i++) 
    { 
       CS1_L; 
      Transfer_command(0xb0+i);   //set page address, 
//      Transfer_command(0x10); 
//      Transfer_command(0x00); 
      for(j=0;j<128;j++) 
      { 
          Transfer_command((0x10)|(j>>4));//刘西振这两行是控制列地址的。
				  Transfer_command((0x00)|(j&0x0f));//
					Transfer_data(*address);     
          address++;        
      } 
    } 
}

//==================display a piture of 128*64 dots================ 
void FullAll(unsigned char dat) 
{ 
    int i,j; 
    for(i=0;i<8;i++) 
    { 
       CS1_L; 
      Transfer_command(0xb0+i);   //set page address, 
//      Transfer_command(0x10); 
//      Transfer_command(0x00); 
      for(j=0;j<128;j++) 
      { 
          Transfer_command((0x10)|(j>>4));//刘西振这两行是控制列地址的。
				  Transfer_command((0x00)|(j&0x0f));//
					Transfer_data(dat);            
      } 
    } 
}


/*=======写指令========*/ 
void Transfer_command(int data1)    
{ 
   char i; 
   CS1_L; 
   RS_L; 
   for(i=0;i<8;i++) 
   { 
      SCK_L; 
      if(data1&0x80) SID_H; 
      else SID_L; 
      Delay1(2); 
      SCK_H; 
      Delay1(2); 
      data1=data1<<=1; 
    } 
} 


/*--------写数据------------*/ 
void Transfer_data(int data1) 
{ 
   char i; 
   CS1_L; 
   RS_H; 
   for(i=0;i<8;i++) 
   { 
      SCK_L; 
      if(data1&0x80) SID_H; 
      else SID_L; 
      SCK_H; 
      data1=data1<<=1; 
    } 
} 
 
/*=========延时=====================*/ 
void Delay(int i)                
{ 
 int j,k; 
 for(j=0;j<i;j++) 
 //for(k=0;k<990;k++); 
	for(k=0;k<800;k++); 
} 
 
/*=========延时=====================*/ 
void Delay1(int i) 
{ 
 int j,k; 
 for(j=0;j<i;j++) 
 for(k=0;k<1;k++); 
} 

/*=========等按键=====================*/ 
void Switch() 
{ 
 repeat: 
//    if (KEY_INT) goto repeat; 

	while(KEY_INT){
		Delay(5);
	}
	// else Delay(1); 
	
//   if (KEY_INT&0x01) goto repeat; 
//   else; 
} 
//-------------------------------------------- 
 
unsigned char graphic1[]={ 
/*--  调入了一幅图像：d:\My Documents\My Pictures\多字.bmp  --*/ 


/*--  宽度 x 高度=128x64  --*/ 
0x00,0x00,0x00,0x00,0x7E,0x2A,0x2A,0x2A,0x2A,0x2A,0x2A,0x7E,0x00,0x00,0x00,0x00, 
0x02,0xFE,0x92,0x92,0x92,0xFE,0x12,0x11,0x12,0x1C,0xF0,0x18,0x17,0x12,0x10,0x00, 
0x20,0x21,0x2E,0xE4,0x00,0x42,0x42,0xFE,0x42,0x42,0x42,0x02,0xFE,0x00,0x00,0x00, 
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0x80,0x81,0x41,0x42,0x22,0x12,0x0E,0x03,0x02,0x42,0x82,0x7E,0x00,0x01,0x00,0x00 
 
}; 



/*****************************************************************************/







